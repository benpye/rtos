MEMORY
{
    rom (rx)    : ORIGIN = 0x20000000, LENGTH = 32M
    ram (rw)    : ORIGIN = 0x80000000, LENGTH = 256k
}

PROVIDE(rtos.PERIPHERAL_PLIC_BASE                   = 0x0c000000);
PROVIDE(rtos.PERIPHERAL_ACLINT_MSWI_BASE            = 0x02000000);
PROVIDE(rtos.PERIPHERAL_ACLINT_MTIMER_COMPARE_BASE  = 0x02004000);
PROVIDE(rtos.PERIPHERAL_ACLINT_MTIMER_TIME_BASE     = 0x0200bff8);

{{> common/device }}
